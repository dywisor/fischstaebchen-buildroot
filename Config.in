## Config.in
```kconfig
source "$BR2_EXTERNAL/package/apt-cacher-ng/Config.in"
source "$BR2_EXTERNAL/package/hacks/Config.in"
source "$BR2_EXTERNAL/package/diskid/Config.in"

menu "fischstaebchen"
	source "$BR2_EXTERNAL/package/fischstaebchen/Config.in"
endmenu
```

## configs/fischstaebchen_big_x86_64_defconfig
```kconfig
BR2_x86_64=y
BR2_OPTIMIZE_2=y
BR2_TOOLCHAIN_BUILDROOT_LARGEFILE=y
BR2_TOOLCHAIN_BUILDROOT_INET_IPV6=y
BR2_TOOLCHAIN_BUILDROOT_INET_RPC=y
BR2_TOOLCHAIN_BUILDROOT_LOCALE=y
BR2_TOOLCHAIN_BUILDROOT_USE_SSP=y
BR2_TOOLCHAIN_BUILDROOT_CXX=y
BR2_GCC_ENABLE_GRAPHITE=y
BR2_ENABLE_LOCALE_PURGE=y
BR2_ENABLE_LOCALE_WHITELIST="C en_US en de_DE de"
BR2_GENERATE_LOCALE="en_US.UTF-8 de_DE.UTF-8"
BR2_TARGET_OPTIMIZATION="-pipe"
BR2_TARGET_GENERIC_HOSTNAME="br-initramfs"
BR2_TARGET_GENERIC_ISSUE="Welcome to Buildroot Fischstaebchen Initramfs"
BR2_TARGET_GENERIC_PASSWD_SHA512=y
BR2_INIT_NONE=y
BR2_TARGET_GENERIC_ROOT_PASSWD="idkfa"
# BR2_TARGET_GENERIC_GETTY is not set
# BR2_TARGET_GENERIC_REMOUNT_ROOTFS_RW is not set
BR2_ROOTFS_OVERLAY="$(BR2_EXTERNAL)/board/fischstaebchen/common/rootfs_overlay"
BR2_ROOTFS_POST_BUILD_SCRIPT="$(BR2_EXTERNAL)/board/fischstaebchen/common/post_build.sh"
BR2_ROOTFS_POST_IMAGE_SCRIPT="$(BR2_EXTERNAL)/board/fischstaebchen/common/post_image.sh"
BR2_PACKAGE_BUSYBOX_CONFIG="$(BR2_EXTERNAL)/board/fischstaebchen/common/busybox.config"
BR2_PACKAGE_BUSYBOX_SHOW_OTHERS=y
BR2_PACKAGE_PV=y
BR2_PACKAGE_E2FSPROGS=y
# BR2_PACKAGE_E2FSPROGS_BADBLOCKS is not set
# BR2_PACKAGE_E2FSPROGS_DUMPE2FS is not set
# BR2_PACKAGE_E2FSPROGS_E2FREEFRAG is not set
# BR2_PACKAGE_E2FSPROGS_E2UNDO is not set
# BR2_PACKAGE_E2FSPROGS_FILEFRAG is not set
# BR2_PACKAGE_E2FSPROGS_FSCK is not set
# BR2_PACKAGE_E2FSPROGS_LOGSAVE is not set
# BR2_PACKAGE_E2FSPROGS_MKLOSTFOUND is not set
# BR2_PACKAGE_E2FSPROGS_UUIDGEN is not set
BR2_PACKAGE_SQUASHFS=y
BR2_PACKAGE_SQUASHFS_LZ4=y
BR2_PACKAGE_SQUASHFS_XZ=y
BR2_PACKAGE_IUCODE_TOOL=y
BR2_PACKAGE_LVM2=y
BR2_PACKAGE_MDADM=y
BR2_PACKAGE_HAVEGED=y
BR2_PACKAGE_DROPBEAR=y
BR2_PACKAGE_DROPBEAR_DISABLE_REVERSEDNS=y
BR2_PACKAGE_RSYNC=y
BR2_PACKAGE_SCREEN=y
BR2_PACKAGE_ACL=y
BR2_PACKAGE_HTOP=y
BR2_PACKAGE_UTIL_LINUX_BINARIES=y
BR2_PACKAGE_UTIL_LINUX_FSCK=y
BR2_PACKAGE_NANO=y
BR2_TARGET_ROOTFS_CPIO=y
BR2_TARGET_ROOTFS_CPIO_XZ=y
# BR2_TARGET_ROOTFS_TAR is not set
BR2_PACKAGE_HACKS=y
BR2_PACKAGE_HACKS_DROP_BUSYBOX_SYMLINKS=y
BR2_PACKAGE_HACKS_INITRAMFS_PURGE=y
BR2_PACKAGE_HACKS_MISC_DOWNSIZE=y
BR2_PACKAGE_HACKS_UTIL_LINUX_DOWNSIZE=y
BR2_PACKAGE_FISCHSTAEBCHEN_INITRAMFS=y
BR2_PACKAGE_FISCHSTAEBCHEN_INIT_ZRAM_TOOLS=y
BR2_PACKAGE_FISCHSTAEBCHEN_INIT_CREATE_USER_TMPDIRS=y
# BR2_PACKAGE_FISCHSTAEBCHEN_CFG_ZRAM_SET_COMPRESSION_AFTER_CLAIM is not set
# BR2_PACKAGE_FISCHSTAEBCHEN_CFG_ZRAM_DISK_ENABLE_EXT2 is not set
# BR2_PACKAGE_FISCHSTAEBCHEN_CFG_ZRAM_DISK_ENABLE_EXT2_EXTERN is not set
BR2_PACKAGE_OPENSSL=y
BR2_PACKAGE_WGET=y
```

## package/apt-cacher-ng/Config.in
```kconfig
config BR2_PACKAGE_APT_CACHER_NG
   bool "apt-cacher-ng"

   depends on BR2_INSTALL_LIBSTDCPP

   help
      A caching proxy.

      Specialized for package files from Linux distributors, primarily
      for Debian (and Debian based) distributions but not limited to those.

      Optional dependencies:

       o zlib
       o xz
       o bzip2
       o openssl

      https://www.unix-ag.uni-kl.de/~bloch/acng/

if BR2_PACKAGE_APT_CACHER_NG

comment "acngfs needs libfuse, which needs a toolchain w/ largefile, threads, dynamic library"
   depends on ( \
      BR2_STATIC_LIBS || !BR2_LARGEFILE || !BR2_TOOLCHAIN_HAS_THREADS || \
      !BR2_USE_MMU )

config BR2_PACKAGE_APT_CACHER_NG_ACNGFS
   bool "acngfs"

   select BR2_PACKAGE_LIBFUSE
   ## propagated dependencies:
   depends on !BR2_STATIC_LIBS
   depends on BR2_LARGEFILE
   depends on BR2_TOOLCHAIN_HAS_THREADS
   depends on BR2_USE_MMU # fork()

endif # BR2_PACKAGE_APT_CACHER_NG
```

## package/diskid/Config.in
```kconfig
config BR2_PACKAGE_DISKID
	bool "diskid"

	help
		`diskid` reads disk identifiers from devices and is a replacement for
		udev's `ata_id` program. This is useful for creating /dev/disk/by-id/
		links on systems where udev/systemd is not installed,
		e.g. when /dev is managed by mdev or devtmpfs.

		https://github.com/dywisor/diskid
```

## package/fischstaebchen/Config.in
```kconfig
# FIXME: "weak" dep on PROG_UNTAR (would at runtime depending on boot params)

comment "fischstaebchen needs busybox or coreutils and util-linux"
	depends on !BR2_PACKAGE_BUSYBOX && ! ( \
			BR2_PACKAGE_UTIL_LINUX && BR2_PACKAGE_COREUTILS )

comment "fischstaebchen-init needs busybox or e2fsprogs w/ mkfs.ext[24]"
	depends on !BR2_PACKAGE_BUSYBOX && !BR2_PACKAGE_E2FSPROGS_MKE2FS

config BR2_PACKAGE_FISCHSTAEBCHEN
	bool

config BR2_PACKAGE_FISCHSTAEBCHEN_INITRAMFS
	bool "initramfs"

	depends on BR2_USE_MMU # fork()
	depends on BR2_PACKAGE_BUSYBOX || ( \
		BR2_PACKAGE_UTIL_LINUX && BR2_PACKAGE_COREUTILS )
	depends on BR2_PACKAGE_BUSYBOX || BR2_PACKAGE_E2FSPROGS_MKE2FS

	select BR2_PACKAGE_FISCHSTAEBCHEN_INIT
	select BR2_PACKAGE_FISCHSTAEBCHEN_INIT_INIT
	select BR2_PACKAGE_FISCHSTAEBCHEN_OVERLAY
	select BR2_PACKAGE_FISCHSTAEBCHEN

	help
		Fischstaebchen initramfs (init + overlay).

menuconfig BR2_PACKAGE_FISCHSTAEBCHEN_INIT
	bool "progs"

	select BR2_PACKAGE_FISCHSTAEBCHEN

	help
		Fischstaebchen's binaries, e.g. init.

if BR2_PACKAGE_FISCHSTAEBCHEN_INIT

	config BR2_PACKAGE_FISCHSTAEBCHEN_INIT_INIT
		bool "init"

		default y
		depends on BR2_USE_MMU # fork()
		depends on BR2_PACKAGE_BUSYBOX || ( \
			BR2_PACKAGE_UTIL_LINUX && BR2_PACKAGE_COREUTILS )
		depends on BR2_PACKAGE_BUSYBOX || BR2_PACKAGE_E2FSPROGS_MKE2FS

	config BR2_PACKAGE_FISCHSTAEBCHEN_INIT_FILESCAN
		bool "filescan"

		default y

	config BR2_PACKAGE_FISCHSTAEBCHEN_INIT_FILESIZE
		bool "filesize"

		default y

	comment "untar needs tar (from busybox or package)"
		depends on !BR2_PACKAGE_BUSYBOX && !BR2_PACKAGE_TAR

	config BR2_PACKAGE_FISCHSTAEBCHEN_INIT_UNTAR
		bool "untar"

		default y
		depends on BR2_USE_MMU # fork()
		depends on BR2_PACKAGE_BUSYBOX || BR2_PACKAGE_TAR

	config BR2_PACKAGE_FISCHSTAEBCHEN_INIT_ZRAM_TOOLS
		bool "ztmpfs / zdisk"

		depends on BR2_USE_MMU # fork()
		depends on BR2_PACKAGE_BUSYBOX || ( \
			BR2_PACKAGE_UTIL_LINUX && BR2_PACKAGE_COREUTILS )
		depends on BR2_PACKAGE_BUSYBOX || BR2_PACKAGE_E2FSPROGS_MKE2FS

	config BR2_PACKAGE_FISCHSTAEBCHEN_INIT_CREATE_USER_TMPDIRS
		bool "create-user-tmpdirs"


menu "Config"

if BR2_PACKAGE_FISCHSTAEBCHEN_INIT_INIT || BR2_PACKAGE_FISCHSTAEBCHEN_INIT_ZRAM
menu "zram options"

	choice
		prompt "zram compression"
		default BR2_PACKAGE_FISCHSTAEBCHEN_ZRAM_COMP_LZ4

		config BR2_PACKAGE_FISCHSTAEBCHEN_ZRAM_COMP_LZ4
			bool "lz4"

		config BR2_PACKAGE_FISCHSTAEBCHEN_ZRAM_COMP_LZO
			bool "lzo"
	endchoice

	config BR2_PACKAGE_FISCHSTAEBCHEN_CFG_ZRAM_DISK_MAKESYM
		bool "create zram disk symlinks in /dev"

		default y

	config BR2_PACKAGE_FISCHSTAEBCHEN_CFG_ZRAM_CLAIM_CHECK_INITSTATE
		bool "check initstate before claiming a zram device"

		default y

	config BR2_PACKAGE_FISCHSTAEBCHEN_CFG_ZRAM_SET_COMPRESSION_AFTER_CLAIM
		bool "set zram compression after claiming the device"

		default y

	config BR2_PACKAGE_FISCHSTAEBCHEN_CFG_ZRAM_DISK_ENABLE_EXT2
		bool "use mkfs.ext2 from busybox"

		default y
		depends on BR2_PACKAGE_BUSYBOX

	config BR2_PACKAGE_FISCHSTAEBCHEN_CFG_ZRAM_DISK_ENABLE_EXT2_EXTERN
		bool "use mkfs.ext2 from e2fsprogs"

		default y
		depends on BR2_PACKAGE_E2FSPROGS_MKE2FS

	comment "ext4-formatted zram disks need e2fsprogs w/ mkfs.ext4"
		depends on !BR2_PACKAGE_E2FSPROGS_MKE2FS

	config BR2_PACKAGE_FISCHSTAEBCHEN_CFG_ZRAM_DISK_ENABLE_EXT4
		bool "use mkfs.ext4"

		default y
		depends on BR2_PACKAGE_E2FSPROGS_MKE2FS

	comment "btrfs-formatted zram disks need btrfs-progs"
		depends on !BR2_PACKAGE_BTRFS_PROGS

	config BR2_PACKAGE_FISCHSTAEBCHEN_CFG_ZRAM_DISK_ENABLE_BTRFS
		bool "use mkfs.btrfs"

		default y
		depends on BR2_PACKAGE_BTRFS_PROGS

	config BR2_PACKAGE_FISCHSTAEBCHEN_CFG_ZRAM_DISK_PREFER_BTRFS
		bool "prefer btrfs over ext2/4"

		depends on BR2_PACKAGE_FISCHSTAEBCHEN_CFG_ZRAM_DISK_ENABLE_BTRFS

endmenu # zram options
endif


	config BR2_PACKAGE_FISCHSTAEBCHEN_CFG_DEFAULT_PATH
		string

		default "/sbin:/usr/sbin:/bin:/usr/bin"

	config BR2_PACKAGE_FISCHSTAEBCHEN_CFG_ENABLE_BUSYBOX
		bool "use busybox applets"

		default y
		depends on BR2_PACKAGE_BUSYBOX

	config BR2_PACKAGE_FISCHSTAEBCHEN_USE_EXTERN_FINDFS
		bool "prefer findfs from util-linux over busybox' applet"

		default y
		depends on BR2_PACKAGE_UTIL_LINUX_BINARIES

		help
			Required for mounting disks by PARTUUID.


	config BR2_PACKAGE_FISCHSTAEBCHEN_CFG_ENABLE_DEVTMPFS
		bool "use devtmpfs"

		default y

	config BR2_PACKAGE_FISCHSTAEBCHEN_CFG_ENABLE_MDEV
		bool "use mdev"

		default y
		depends on BR2_PACKAGE_BUSYBOX

if BR2_PACKAGE_FISCHSTAEBCHEN_CFG_ENABLE_MDEV
	config BR2_PACKAGE_FISCHSTAEBCHEN_CFG_MDEV_SEQ
		bool "run mdev in sequential mode"

		default y

	config BR2_PACKAGE_FISCHSTAEBCHEN_CFG_MDEV_LOG
		bool "run mdev in logged mode"

endif

	config BR2_PACKAGE_FISCHSTAEBCHEN_DEVFS_TTY_GID
		string "id of the tty group"
		default "5"

	config BR2_PACKAGE_FISCHSTAEBCHEN_DEVFS_DISK_GID
		string "id of the disk group"
		default "6"

	config BR2_PACKAGE_FISCHSTAEBCHEN_DEVFS_CDROM_GID
		string "id of the cdrom group"
		default "0"

endmenu

endif # BR2_PACKAGE_FISCHSTAEBCHEN_INIT

config BR2_PACKAGE_FISCHSTAEBCHEN_OVERLAY
	bool "overlay"

	depends on BR2_PACKAGE_BUSYBOX || ( \
		BR2_PACKAGE_UTIL_LINUX && BR2_PACKAGE_COREUTILS )
	select BR2_PACKAGE_FISCHSTAEBCHEN

	help
		Fischstaebchen's initramfs files (shell scripts etc.).

if BR2_PACKAGE_FISCHSTAEBCHEN_OVERLAY
menu "select overlays"

	config BR2_PACKAGE_FISCHSTAEBCHEN_OVERLAY_BASE
		bool

		default y

		help
			Hook script logic, essential functions, networking.

	config BR2_PACKAGE_FISCHSTAEBCHEN_OVERLAY_SEPARATE_USR
		bool

		default y

		help
			Empty overlay.

	config BR2_PACKAGE_FISCHSTAEBCHEN_OVERLAY_PHASEOUT
		bool "phaseout"

		default y

		help
			Advanced hook script logic,
			required for sub-phases fetching scripts on-the-fly.

	config BR2_PACKAGE_FISCHSTAEBCHEN_OVERLAY_UNION_MOUNT_BASE
		bool "union_mount base"

		default y

		help
			Contains everything required for defining a custom union mount layout.

	config BR2_PACKAGE_FISCHSTAEBCHEN_OVERLAY_UNION_MOUNT
		bool "union_mount"

		default y
		select BR2_PACKAGE_FISCHSTAEBCHEN_OVERLAY_UNION_MOUNT_BASE

		help
			Default union mount layouts - volatile_rootfs, squashed_usr, etc.

	config BR2_PACKAGE_FISCHSTAEBCHEN_OVERLAY_STAGEDIVE
		bool "stagedive"

		default y
		select BR2_PACKAGE_FISCHSTAEBCHEN_OVERLAY_PHASEOUT
		select BR2_PACKAGE_FISCHSTAEBCHEN_OVERLAY_UNION_MOUNT
		select BR2_PACKAGE_FISCHSTAEBCHEN_OVERLAY_UNION_MOUNT_BASE

		help
			Set up a live system - networking, passwd, live user, ....


	config BR2_PACKAGE_FISCHSTAEBCHEN_OVERLAY_DOTFILES
		bool "dotfiles"

		default y

		depends on BR2_USE_MMU # fork()
		depends on BR2_PACKAGE_BUSYBOX || BR2_PACKAGE_TAR
		select BR2_PACKAGE_FISCHSTAEBCHEN_INIT
		select BR2_PACKAGE_FISCHSTAEBCHEN_INIT_UNTAR

		help
			Allows to fetch system and user config files during boot.

			When used with "stagedive", allows to install these files
			during bootstrap and/or setup.

	config BR2_PACKAGE_FISCHSTAEBCHEN_OVERLAY_SQUASHED_ROOTFS
		bool "sfsroot import"

		default y

		help
			Boot a system where rootfs is empty and /usr/rootfs contains
			files (and optionally setup instructions) for creating essentials
			files/dirs/links in /.

	config BR2_PACKAGE_FISCHSTAEBCHEN_OVERLAY_NEWROOT_HOOKS
		bool "newroot hooks"

		default y

		help
			Runs scripts from the target rootfs during boot.

	config BR2_PACKAGE_FISCHSTAEBCHEN_OVERLAY_MISC
		bool "misc"

		default y

		help
			Contains a few non-essential hooks:

			* load CPU microcode
			* transfer initramfs logfile to the <rootfs>
			* create all mountpoints in <rootfs>
			* copy kernel modules/firmare to <rootfs>

	config BR2_PACKAGE_FISCHSTAEBCHEN_OVERLAY_CUSTOM_LIST
		string "additional overlays"

		default ""

		help
			This option is useless. FIXME REMOVE THIS OPTION

endmenu

if BR2_PACKAGE_FISCHSTAEBCHEN_OVERLAY_STAGEDIVE


menu "select stagedive bootstrap targets"

	config BR2_PACKAGE_FISCHSTAEBCHEN_OVERLAY_STAGEDIVE_BOOTSTRAP_ARCH
		bool "Arch Linux"

		default y

		depends on BR2_i386 || BR2_x86_64
		depends on BR2_USE_MMU # fork()
		depends on BR2_PACKAGE_BUSYBOX || BR2_PACKAGE_TAR
		select BR2_PACKAGE_FISCHSTAEBCHEN_INIT
		select BR2_PACKAGE_FISCHSTAEBCHEN_INIT_UNTAR

		help
			Fetch an Arch Linux bootstrap image, bootstrap the target system,
			install additional packages, boot it.

			Features a complete openbox-based live system.

			Can also  boot into the bootstrap image.

			Big and x86/x86_64 only.

	config BR2_PACKAGE_FISCHSTAEBCHEN_OVERLAY_STAGEDIVE_BOOTSTRAP_GENTOO
		bool "Gentoo stage3"

		default y

		depends on BR2_USE_MMU # fork()
		depends on BR2_PACKAGE_BUSYBOX || BR2_PACKAGE_TAR
		select BR2_PACKAGE_FISCHSTAEBCHEN_INIT
		select BR2_PACKAGE_FISCHSTAEBCHEN_INIT_UNTAR

		help
			Fetch the latest stage3 tarball from the official mirrors and boot it.

			Supports various arches and is rather small.

	config BR2_PACKAGE_FISCHSTAEBCHEN_OVERLAY_CFG_OFFENSIVE
		bool "allow offensive actions"

		help
			Certain taks, e.g. repeatedly downloading the same file(s)
			from a server might be considered inappropriate by the owner
			and can lead to a (usually temporary) ban, not to mention the huge
			waste of bandwidth on both ends.

			The bootstrap scripts will be unable to fetch files directly
			(from official mirrors) if this option is not set.
			You'll have to use an proxy, e.g. apt-cacher-ng or specify the
			full file uri ("http://here/i/go").

			Leave this option as-is (n) if apt-cacher-ng is running on the
			local net and you want to ensure that a proxy is always used when
			downloading images/packages.

			Consider installing apt-cacher-ng before setting this option to y.

endmenu
endif # BR2_PACKAGE_FISCHSTAEBCHEN_OVERLAY_STAGEDIVE

	config BR2_PACKAGE_FISCHSTAEBCHEN_OVERLAY_TELINIT
		bool "install telinit"

		default y

		help
			Install the default "telinit" script,
			which takes care of bringing down networking, unmounting disks etc.

endif # BR2_PACKAGE_FISCHSTAEBCHEN_OVERLAY
```

## package/hacks/Config.in
```kconfig
menuconfig BR2_PACKAGE_HACKS
	bool "hacks"

if BR2_PACKAGE_HACKS

config BR2_PACKAGE_HACKS_DROP_BUSYBOX_SYMLINKS
	bool "remove busybox symlinks"

	depends on BR2_PACKAGE_BUSYBOX

config BR2_PACKAGE_HACKS_INITRAMFS_PURGE
	bool "remove files not needed for initramfs"

config BR2_PACKAGE_HACKS_MISC_DOWNSIZE
	bool "remove misc unneeded programs"

config BR2_PACKAGE_HACKS_UTIL_LINUX_DOWNSIZE
	bool "remove unneeded programs installed by util-linux"

endif # BR2_PACKAGE_HACKS
```
